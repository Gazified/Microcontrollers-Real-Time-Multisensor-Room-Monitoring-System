#include "display.h"
#if defined(ESP_PLATFORM)
#include "rtos_objects.h"
#include "sensors.h"
#include "driver/i2c.h"
#include "esp_log.h"
#endif
#include <string.h>
#include <stdio.h>

DisplayMode gCurrentDisplayMode = DisplayMode::TEMPERATURE;

DisplayMode nextDisplayMode(DisplayMode current)
{
    switch (current) {
        case DisplayMode::TEMPERATURE: return DisplayMode::HUMIDITY;
        case DisplayMode::HUMIDITY:    return DisplayMode::LIGHT;
        case DisplayMode::LIGHT:       return DisplayMode::MOTION;
        case DisplayMode::MOTION:      return DisplayMode::TEMPERATURE;
        default:                       return DisplayMode::TEMPERATURE;
    }
}

DisplayMode previousDisplayMode(DisplayMode current)
{
    switch (current) {
        case DisplayMode::TEMPERATURE: return DisplayMode::MOTION;
        case DisplayMode::HUMIDITY:    return DisplayMode::TEMPERATURE;
        case DisplayMode::LIGHT:       return DisplayMode::HUMIDITY;
        case DisplayMode::MOTION:      return DisplayMode::LIGHT;
        default:                       return DisplayMode::TEMPERATURE;
    }
}

#if defined(ESP_PLATFORM)
// 128x64 frame buffer (1024 bytes)
static uint8_t s_buffer[1024];

// Basic 8x8 font for ASCII 32..126
static const uint8_t font8x8_basic[96][8] = {
    {0x00,0x00,0x00,0x00,0x00,0x00,0x00,0x00}, // 32 ' '
    {0x18,0x3C,0x3C,0x18,0x18,0x00,0x18,0x00}, // 33 '!'
    {0x66,0x66,0x24,0x00,0x00,0x00,0x00,0x00}, // 34 '"'
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    {0x76,0xDC,0x00,0x00,0x00,0x00,0x00,0x00}  // 126 '~'
};

static esp_err_t oledWriteCommand(uint8_t cmd)
{
    i2c_cmd_handle_t handle = i2c_cmd_link_create();
    i2c_master_start(handle);
    i2c_master_write_byte(handle, (SSD1306_I2C_ADDR << 1) | I2C_MASTER_WRITE, true);
    i2c_master_write_byte(handle, 0x00, true); // Control byte: Command
    i2c_master_write_byte(handle, cmd, true);
    i2c_master_stop(handle);
    esp_err_t ret = i2c_master_cmd_begin(I2C_NUM_0, handle, pdMS_TO_TICKS(100));
    i2c_cmd_link_delete(handle);
    return ret;
}

static esp_err_t oledWriteData(const uint8_t *data, size_t length)
{
    i2c_cmd_handle_t handle = i2c_cmd_link_create();
    i2c_master_start(handle);
    i2c_master_write_byte(handle, (SSD1306_I2C_ADDR << 1) | I2C_MASTER_WRITE, true);
    i2c_master_write_byte(handle, 0x40, true); // Control byte: Data stream
    i2c_master_write(handle, const_cast<uint8_t*>(data), length, true);
    i2c_master_stop(handle);
    esp_err_t ret = i2c_master_cmd_begin(I2C_NUM_0, handle, pdMS_TO_TICKS(100));
    i2c_cmd_link_delete(handle);
    return ret;
}

void initOLED(void)
{
    i2c_config_t conf = {};
    conf.mode = I2C_MODE_MASTER;
    conf.sda_io_num = (gpio_num_t)OLED_I2C_SDA_GPIO;
    conf.sda_pullup_en = GPIO_PULLUP_ENABLE;
    conf.scl_io_num = (gpio_num_t)OLED_I2C_SCL_GPIO;
    conf.scl_pullup_en = GPIO_PULLUP_ENABLE;
    conf.master.clk_speed = 400000;

    i2c_param_config(I2C_NUM_0, &conf);
    i2c_driver_install(I2C_NUM_0, conf.mode, 0, 0, 0);

    // Initialization sequence for SSD1306 128x64
    oledWriteCommand(0xAE); // Display off
    oledWriteCommand(0xD5); oledWriteCommand(0x80); // Set clock divide ratio
    oledWriteCommand(0xA8); oledWriteCommand(0x3F); // Multiplex 64
    oledWriteCommand(0xD3); oledWriteCommand(0x00); // Display offset 0
    oledWriteCommand(0x40);                         // Start line 0
    oledWriteCommand(0x8D); oledWriteCommand(0x14); // Enable charge pump
    oledWriteCommand(0x20); oledWriteCommand(0x00); // Horizontal addressing mode
    oledWriteCommand(0xA1);                         // Segment re-map (col 127 = SEG0)
    oledWriteCommand(0xC8);                         // COM output scan direction
    oledWriteCommand(0xDA); oledWriteCommand(0x12); // COM pins hardware config
    oledWriteCommand(0x81); oledWriteCommand(0xCF); // Contrast control
    oledWriteCommand(0xD9); oledWriteCommand(0xF1); // Pre-charge period
    oledWriteCommand(0xDB); oledWriteCommand(0x40); // VCOMH deselect level
    oledWriteCommand(0xA4);                         // Resume to RAM content
    oledWriteCommand(0xA6);                         // Normal display (non-inverted)
    oledWriteCommand(0xAF);                         // Display on
}

static void oledClearBuffer(void)
{
    memset(s_buffer, 0, sizeof(s_buffer));
}

static void oledDrawChar(int x, int page, char c)
{
    if (x < 0 || x > 120 || page < 0 || page > 7) return;
    if (c < 32 || c > 126) c = ' ';
    const uint8_t *glyph = font8x8_basic[c - 32];

    for (int col = 0; col < 8; col++) {
        uint8_t col_data = 0;
        for (int row = 0; row < 8; row++) {
            if ((glyph[row] >> (7 - col)) & 0x01) {
                col_data |= (1 << row);
            }
        }
        s_buffer[page * 128 + x + col] = col_data;
    }
}

static void oledDrawString(int x, int page, const char *str)
{
    int cur_x = x;
    while (*str && cur_x <= 120) {
        oledDrawChar(cur_x, page, *str);
        cur_x += 8;
        str++;
    }
}

static void oledFlush(void)
{
    oledWriteCommand(0x21); oledWriteCommand(0); oledWriteCommand(127); // Column 0..127
    oledWriteCommand(0x22); oledWriteCommand(0); oledWriteCommand(7);   // Page 0..7
    oledWriteData(s_buffer, sizeof(s_buffer));
}

void displayTask(void *pvParameters)
{
    (void)pvParameters;
    initOLED();

    safeSerialPrintf("[DisplayTask] Started on Core %d, Priority %d (OLED Owner)\n",
                     xPortGetCoreID(), uxTaskPriorityGet(NULL));

    SensorData lastData = {
        .temperature = 24.0f,
        .humidity = 50.0f,
        .lightLevel = 50,
        .motionDetected = false
    };

    char line1[20];
    char line2[20];
    char statusLine[20];

    for (;;) {
        // Wait for fresh sensor data (up to 300ms, then refresh display)
        SensorData received;
        if (xQueueReceive(xSensorQueueDisplay, &received, pdMS_TO_TICKS(300)) == pdTRUE) {
            lastData = received;
        }

        EventBits_t events = xEventGroupGetBits(xSystemEvents);
        bool isActive = (events & EVENT_ACTIVE) != 0;
        bool isAlarm = (events & EVENT_ALARM) != 0;

        oledClearBuffer();

        if (!isActive) {
            // INACTIVE state: blank screen for power saving (Section 34)
            oledDrawString(24, 3, "SYSTEM SLEEP");
            oledDrawString(16, 5, "[PIR to Wake]");
            oledFlush();
            vTaskDelay(pdMS_TO_TICKS(200));
            continue;
        }

        // Header
        oledDrawString(12, 0, "ROOM MONITOR");

        // Format specific selected measurement (Section 4 FR-05)
        switch (gCurrentDisplayMode) {
            case DisplayMode::TEMPERATURE:
                snprintf(line1, sizeof(line1), "PAGE: TEMPERATURE");
                snprintf(line2, sizeof(line2), "Temp: %.1f C", lastData.temperature);
                break;
            case DisplayMode::HUMIDITY:
                snprintf(line1, sizeof(line1), "PAGE: HUMIDITY");
                snprintf(line2, sizeof(line2), "Hum : %.1f %%", lastData.humidity);
                break;
            case DisplayMode::LIGHT:
                snprintf(line1, sizeof(line1), "PAGE: AMBIENT LIGHT");
                snprintf(line2, sizeof(line2), "Light: %d %%", lastData.lightLevel);
                break;
            case DisplayMode::MOTION:
                snprintf(line1, sizeof(line1), "PAGE: PIR MOTION");
                snprintf(line2, sizeof(line2), "Motion: %s", lastData.motionDetected ? "DETECTED" : "CLEAR");
                break;
        }

        oledDrawString(0, 2, line1);
        oledDrawString(8, 4, line2);

        if (isAlarm) {
            snprintf(statusLine, sizeof(statusLine), "! TEMP ALARM !");
        } else {
            snprintf(statusLine, sizeof(statusLine), "[ENC: Navigate]");
        }
        oledDrawString(4, 7, statusLine);

        oledFlush();
        vTaskDelay(pdMS_TO_TICKS(150));
    }
}
#endif
